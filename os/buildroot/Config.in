## os/buildroot/Config.in
```kconfig
source "$BR2_EXTERNAL_OSCAIRN_PATH/package/oscairn/Config.in"
source "$BR2_EXTERNAL_OSCAIRN_PATH/package/oscairn-juce/Config.in"
```

## os/buildroot/configs/experiments/bluetooth_bluealsa_defconfig
```kconfig
# Bluetooth stack measurement (RFC 0036), BlueALSA: the baseline plus BlueZ with its MIDI plugin,
# bluez-alsa and SBC (BlueZ brings D-Bus and GLib), and Bluetooth in the kernel with the virtual
# HCI driver. See board/experiments/bluetooth.
BR2_aarch64=y
BR2_cortex_a76_a55=y
BR2_TOOLCHAIN_BUILDROOT_GLIBC=y
BR2_TOOLCHAIN_BUILDROOT_CXX=y
BR2_PACKAGE_HOST_LINUX_HEADERS_CUSTOM_6_18=y
BR2_CCACHE=y
BR2_GLOBAL_PATCH_DIR="board/qemu/patches"
BR2_DOWNLOAD_FORCE_CHECK_HASHES=y
BR2_TARGET_GENERIC_HOSTNAME="oscairn"
BR2_TARGET_GENERIC_ISSUE="Oscairn"
BR2_ROOTFS_DEVICE_CREATION_DYNAMIC_EUDEV=y
BR2_ROOTFS_OVERLAY="$(BR2_EXTERNAL_OSCAIRN_PATH)/board/common/session-juce-x11"
BR2_ROOTFS_POST_BUILD_SCRIPT="$(BR2_EXTERNAL_OSCAIRN_PATH)/board/common/post-build.sh"
BR2_LINUX_KERNEL=y
BR2_LINUX_KERNEL_CUSTOM_VERSION=y
BR2_LINUX_KERNEL_CUSTOM_VERSION_VALUE="6.18.7"
BR2_LINUX_KERNEL_USE_CUSTOM_CONFIG=y
BR2_LINUX_KERNEL_CUSTOM_CONFIG_FILE="board/qemu/aarch64-virt/linux.config"
BR2_LINUX_KERNEL_CONFIG_FRAGMENT_FILES="$(BR2_EXTERNAL_OSCAIRN_PATH)/board/qemu-aarch64/linux.fragment $(BR2_EXTERNAL_OSCAIRN_PATH)/board/experiments/bluetooth/linux.fragment"
BR2_LINUX_KERNEL_NEEDS_HOST_OPENSSL=y
BR2_PACKAGE_XORG7=y
BR2_PACKAGE_XSERVER_XORG_SERVER=y
BR2_PACKAGE_XSERVER_XORG_SERVER_MODULAR=y
BR2_PACKAGE_XDRIVER_XF86_INPUT_LIBINPUT=y
BR2_PACKAGE_XDRIVER_XF86_VIDEO_FBDEV=y
BR2_PACKAGE_DEJAVU=y
BR2_PACKAGE_ALSA_UTILS=y
BR2_PACKAGE_ALSA_UTILS_APLAY=y
BR2_PACKAGE_OSCAIRN=y
BR2_PACKAGE_OSCAIRN_STANDALONE=y
BR2_TARGET_ROOTFS_EXT2=y
BR2_TARGET_ROOTFS_EXT2_4=y
BR2_TARGET_ROOTFS_EXT2_SIZE="512M"
# BR2_TARGET_ROOTFS_TAR is not set
BR2_PACKAGE_BLUEZ5_UTILS=y
BR2_PACKAGE_BLUEZ5_UTILS_PLUGINS_AUDIO=y
BR2_PACKAGE_BLUEZ5_UTILS_PLUGINS_MIDI=y
BR2_PACKAGE_BLUEZ_ALSA=y
BR2_PACKAGE_SBC=y
```

## os/buildroot/configs/oscairn_qemu_aarch64_defconfig
```kconfig
# Oscairn on QEMU's generic ARM64 machine (virt), with a Cortex-A76/A55 CPU like the
# RK3588's. For testing the image and the app's startup; QEMU has no RK3588 or i.MX8M model.
BR2_aarch64=y
BR2_cortex_a76_a55=y
BR2_TOOLCHAIN_BUILDROOT_GLIBC=y
BR2_TOOLCHAIN_BUILDROOT_CXX=y
BR2_PACKAGE_HOST_LINUX_HEADERS_CUSTOM_6_18=y
BR2_CCACHE=y
BR2_GLOBAL_PATCH_DIR="board/qemu/patches"
BR2_DOWNLOAD_FORCE_CHECK_HASHES=y
BR2_TARGET_GENERIC_HOSTNAME="oscairn"
BR2_TARGET_GENERIC_ISSUE="Oscairn"
BR2_ROOTFS_DEVICE_CREATION_DYNAMIC_EUDEV=y
BR2_ROOTFS_OVERLAY="$(BR2_EXTERNAL_OSCAIRN_PATH)/board/common/session-juce-x11"
BR2_ROOTFS_POST_BUILD_SCRIPT="$(BR2_EXTERNAL_OSCAIRN_PATH)/board/common/post-build.sh"
BR2_LINUX_KERNEL=y
BR2_LINUX_KERNEL_CUSTOM_VERSION=y
BR2_LINUX_KERNEL_CUSTOM_VERSION_VALUE="6.18.7"
BR2_LINUX_KERNEL_USE_CUSTOM_CONFIG=y
BR2_LINUX_KERNEL_CUSTOM_CONFIG_FILE="board/qemu/aarch64-virt/linux.config"
BR2_LINUX_KERNEL_CONFIG_FRAGMENT_FILES="$(BR2_EXTERNAL_OSCAIRN_PATH)/board/qemu-aarch64/linux.fragment"
BR2_LINUX_KERNEL_NEEDS_HOST_OPENSSL=y
BR2_PACKAGE_XORG7=y
BR2_PACKAGE_XSERVER_XORG_SERVER=y
BR2_PACKAGE_XSERVER_XORG_SERVER_MODULAR=y
BR2_PACKAGE_XDRIVER_XF86_INPUT_LIBINPUT=y
BR2_PACKAGE_XDRIVER_XF86_VIDEO_FBDEV=y
BR2_PACKAGE_DEJAVU=y
BR2_PACKAGE_ALSA_UTILS=y
BR2_PACKAGE_ALSA_UTILS_APLAY=y
BR2_PACKAGE_OSCAIRN=y
BR2_PACKAGE_OSCAIRN_STANDALONE=y
BR2_TARGET_ROOTFS_EXT2=y
BR2_TARGET_ROOTFS_EXT2_4=y
BR2_TARGET_ROOTFS_EXT2_SIZE="512M"
# BR2_TARGET_ROOTFS_TAR is not set
```

## os/buildroot/package/oscairn-juce/Config.in
```kconfig
config BR2_PACKAGE_OSCAIRN_JUCE
	bool
	help
	  The JUCE source, for building the Oscairn app. Nothing is
	  installed on the target.
```

## os/buildroot/package/oscairn-legacy-sampler/Config.in
```kconfig
config BR2_PACKAGE_OSCAIRN_LEGACY_SAMPLER
	bool
	help
	  The Oscairn Legacy Sampler source (github.com/oscairn/sampler),
	  for building it with Oscairn. Nothing is installed by this
	  package.
```

## os/buildroot/package/oscairn-sampler/Config.in
```kconfig
config BR2_PACKAGE_OSCAIRN_SAMPLER
	bool
	help
	  The Oscairn Sampler source (github.com/oscairn/sampler), for
	  building it with Oscairn. Nothing is installed by this package.
```

## os/buildroot/package/oscairn/Config.in
```kconfig
config BR2_PACKAGE_OSCAIRN
	bool "oscairn"
	depends on BR2_INSTALL_LIBSTDCPP
	depends on BR2_TOOLCHAIN_HAS_THREADS
	depends on BR2_TOOLCHAIN_GCC_AT_LEAST_12 # C++20
	help
	  Oscairn, an open instrument platform: the plugin host core,
	  the first-party CLAP plugins (installed to /usr/lib/clap) and
	  oscairn-render.

	  https://github.com/jbschooley/oscairn

if BR2_PACKAGE_OSCAIRN

config BR2_PACKAGE_OSCAIRN_STANDALONE
	bool "desktop app (JUCE, X11)"
	depends on BR2_PACKAGE_XORG7
	depends on BR2_TOOLCHAIN_USES_GLIBC
	select BR2_PACKAGE_OSCAIRN_JUCE
	select BR2_PACKAGE_ALSA_LIB
	select BR2_PACKAGE_FREETYPE
	select BR2_PACKAGE_FONTCONFIG
	select BR2_PACKAGE_XLIB_LIBX11
	select BR2_PACKAGE_XLIB_LIBXEXT
	select BR2_PACKAGE_XLIB_LIBXINERAMA
	select BR2_PACKAGE_XLIB_LIBXRANDR
	select BR2_PACKAGE_XLIB_LIBXCURSOR
	select BR2_PACKAGE_XLIB_LIBXRENDER
	help
	  The Oscairn app with its screen and panel layouts, built
	  with JUCE. Needs an X11 display. It is the only part of the
	  image that uses JUCE or X11.

comment "the desktop app needs X.org and a glibc toolchain"
	depends on !BR2_PACKAGE_XORG7 || !BR2_TOOLCHAIN_USES_GLIBC

endif

comment "oscairn needs a toolchain w/ C++, threads, gcc >= 12"
	depends on !BR2_INSTALL_LIBSTDCPP || !BR2_TOOLCHAIN_HAS_THREADS || \
		!BR2_TOOLCHAIN_GCC_AT_LEAST_12
```
